## Config.in
```kconfig
menu "Wraketti"

config BR2_TARGET_GENERIC_HOSTNAME
    string "Hotspot SSID"
    default "wraketti"
    help
      Selects hotspot SSID.

endmenu
```

## configs/wraketti_defconfig
```kconfig
BR2_arm=y
BR2_cortex_a7=y
BR2_ARM_EABIHF=y
BR2_ARM_FPU_NEON_VFPV4=y

BR2_TOOLCHAIN_BUILDROOT_CXX=y

BR2_TARGET_GENERIC_GETTY_PORT="tty1"
BR2_TARGET_GENERIC_HOSTNAME="wraketti"

# Lock to 4.0 headers as the RPi kernel stable tree is
# based off the 4.0 branch
BR2_KERNEL_HEADERS_VERSION=y
BR2_DEFAULT_KERNEL_VERSION="4.0.6"
BR2_PACKAGE_HOST_LINUX_HEADERS_CUSTOM_4_0=y

BR2_LINUX_KERNEL=y
BR2_LINUX_KERNEL_CUSTOM_GIT=y
BR2_LINUX_KERNEL_CUSTOM_REPO_URL="https://github.com/raspberrypi/linux.git"
BR2_LINUX_KERNEL_CUSTOM_REPO_VERSION="f90f981770e3ac8506dc84c9cd01471faaa0b0c2"
BR2_LINUX_KERNEL_DEFCONFIG="bcm2709"
BR2_LINUX_KERNEL_ZIMAGE=y

# Build the DTB from the kernel sources
BR2_LINUX_KERNEL_DTS_SUPPORT=y
BR2_LINUX_KERNEL_INTREE_DTS_NAME="bcm2709-rpi-2-b"

BR2_PACKAGE_RPI_FIRMWARE=y
# BR2_PACKAGE_RPI_FIRMWARE_INSTALL_DTB_OVERLAYS is not set

BR2_TOOLCHAIN_BUILDROOT_WCHAR=y
BR2_USE_WCHAR=y

BR2_PACKAGE_NODEJS=y
BR2_PACKAGE_ZLIB=y
BR2_BR2_PACKAGE_NODEJS_0_10_X=y
BR2_PACKAGE_NODEJS_NPM=y
BR2_PACKAGE_OPENSSL=y

BR2_PACKAGE_DNSMASQ=y
BR2_PACKAGE_DNSMASQ_DHCP=y

BR2_ROOTFS_OVERLAY="$(BR2_EXTERNAL)/board/asuuri/wraketti/rootfs_overlay/"
BR2_TARGET_GENERIC_ROOT_PASSWD="Salakal4"
BR2_SYSTEM_DHCP="eth0"
```
